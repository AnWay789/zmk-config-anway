## Kconfig
```kconfig
config TRACKPAD_CAL
	bool
	default y
	select LV_USE_LABEL if ZMK_DISPLAY
	imply LV_USE_THEME_MONO if ZMK_DISPLAY

config TRACKPAD_CAL_DEFAULT_ANGLE
	int
	default 335
	range 0 359
	help
	  Extra tilt after Cirque rotate-90. 335 = -25 degrees.

if ZMK_DISPLAY && ZMK_DISPLAY_STATUS_SCREEN_CUSTOM

config LV_FONT_MONTSERRAT_16
	default y

config LV_FONT_MONTSERRAT_12
	default y

config LV_Z_MEM_POOL_SIZE
	default 4096

endif
```

## dts/bindings/behaviors/zmk,behavior-trackpad-rotate.yaml
```yaml
description: Adjust extra trackpad tilt in degrees (0 = reset)

compatible: "zmk,behavior-trackpad-rotate"

properties:
  "#binding-cells":
    type: int
    required: true
    const: 1

binding-cells:
  - param1
```

## dts/bindings/input_processors/zmk,input-processor-trackpad-rotate.yaml
```yaml
description: Runtime XY rotation for the trackpad

compatible: "zmk,input-processor-trackpad-rotate"

properties:
  "#input-processor-cells":
    type: int
    required: true
    const: 0
  track-remainders:
    type: boolean
```
